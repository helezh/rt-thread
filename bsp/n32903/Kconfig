## bsp/n32903/Kconfig
```kconfig
mainmenu "RT-Thread Configuration"

config $BSP_DIR
    string
    option env="BSP_ROOT"
    default "."

config $RTT_DIR
    string
    option env="RTT_ROOT"
    default "../.."

config $PKGS_DIR
    string
    option env="PKGS_ROOT"
    default "packages"

source "$RTT_DIR/Kconfig"
source "$PKGS_DIR/Kconfig"

config RT_USING_UART1
    bool "Using RT_USING_UART1"
    default y
	
config RT_USING_LED
	bool "Using RT_USING_LED"
	default y
	help
		led blink demo
 
```
